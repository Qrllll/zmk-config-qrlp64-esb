## config/west.yml
```yaml
manifest:
  remotes:
    - name: Qrllll
      url-base: https://github.com/Qrllll
    
  projects:
    - name: zmk
      remote: Qrllll
      revision: feat/deskhop-sync
      import: app/west.yml
    - name: qr-zmk-feature-split-esb
      remote: Qrllll
      revision: main
      import: true
    - name: zmk-dongle-display
      remote: Qrllll
      revision: main
  self:
    path: config
```
