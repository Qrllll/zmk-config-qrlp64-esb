## boards/shields/qrlp64/Kconfig.defconfig
```kconfig
if SHIELD_MY_BOARD_DONGLE

config ZMK_KEYBOARD_NAME
	default "qrlp64"

config ZMK_SPLIT_ROLE_CENTRAL
	default y

config ZMK_SPLIT
	default y

endif
```

## boards/shields/qrlp64/Kconfig.shield
```kconfig
config SHIELD_MY_BOARD_DONGLE
def_bool $(shields_list_contains,qrlp64_dongle)

config SHIELD_MY_BOARD_LEFT
def_bool $(shields_list_contains,qrlp64_left)

config SHIELD_MY_BOARD_RIGHT
def_bool $(shields_list_contains,qrlp64_right)
```
