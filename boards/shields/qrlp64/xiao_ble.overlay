/*
 * OLED for the XIAO BLE dongle only (the nice_nano dongle build has no display).
 * Wiring: SDA = D4, SCL = D5, plus 3V3 and GND. 128x64 SSD1306 at 0x3c.
 * 1.3" SH1106: compatible = "sinowealth,sh1106" and segment-offset = <2>.
 * 0.91" 128x32: height = <32> and multiplex-ratio = <31>.
 */
/ {
    chosen {
        zephyr,display = &oled;
    };
};

&xiao_i2c {
    status = "okay";

    oled: ssd1306@3c {
        compatible = "solomon,ssd1306fb";
        reg = <0x3c>;
        width = <128>;
        height = <64>;
        segment-offset = <0>;
        page-offset = <0>;
        display-offset = <0>;
        multiplex-ratio = <63>;
        segment-remap;
        com-invdir;
        prechargep = <0x22>;
    };
};
