#include "qrlp64.dtsi" // Reuse the same kscan/transform skeleton as keyboard 1.
#include "qrlp64_esb_addr.dtsi"
/ { chosen { zmk,esb-self = &qrsplit64_left; }; };

#include <dt-bindings/zmk/mouse.h>

&default_transform {
	row-offset = <5>; // Lands kb2's rows in 5-9 instead of 0-4, so its
	                  // positions are 70-139, not a collision with kb1's 0-69.
};

&kscan0 {
row-gpios
= <&pro_micro 3 (GPIO_ACTIVE_HIGH  | GPIO_PULL_DOWN)>
, <&pro_micro 4 (GPIO_ACTIVE_HIGH  | GPIO_PULL_DOWN)>
, <&pro_micro 5 (GPIO_ACTIVE_HIGH  | GPIO_PULL_DOWN)>
, <&pro_micro 6 (GPIO_ACTIVE_HIGH  | GPIO_PULL_DOWN)>
, <&pro_micro 7 (GPIO_ACTIVE_HIGH  | GPIO_PULL_DOWN)>
;
	col-gpios
		= <&pro_micro 21 GPIO_ACTIVE_HIGH>
		, <&pro_micro 20 GPIO_ACTIVE_HIGH>
		, <&pro_micro 19 GPIO_ACTIVE_HIGH>
		, <&pro_micro 18 GPIO_ACTIVE_HIGH>
		, <&pro_micro 15 GPIO_ACTIVE_HIGH>
		, <&pro_micro 14 GPIO_ACTIVE_HIGH>
		;
};